#include <WiFiManager.h> // https://github.com/tzapu/WiFiManager
#include <Wire.h>
#include <Adafruit_GFX.h>
#include <Adafruit_SSD1306.h>
#include "esp_camera.h"
#include <WiFi.h>

// Definições do display OLED
#define SCREEN_I2C_ADDR 0x3C
#define SCREEN_WIDTH 128
#define SCREEN_HEIGHT 64
#define OLED_RST_PIN -1
Adafruit_SSD1306 display(SCREEN_WIDTH, SCREEN_HEIGHT, &Wire, OLED_RST_PIN);

// Definições da animação
#define FRAME_DELAY (42)
const byte PROGMEM frames[][512] = {
    // Frames da animação
    {0,0,0,0,0,0,0,0,0,0,0,0,0,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0,0},
  {0,0,0,0,0,0,0,0,0,0,0,0,0,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0,0},
  {0,0,0,0,0,0,0,0,0,0,0,0,0,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0,0},
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  {0,0,0,0,0,0,0,0,0,0,0,0,0,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0,0}
};
#define FRAME_COUNT (sizeof(frames) / sizeof(frames[0]))
#define FRAME_WIDTH 64
#define FRAME_HEIGHT 64

void runAnimation() {
    for (int frame = 0; frame < FRAME_COUNT; frame++) {
        display.clearDisplay();
        display.drawBitmap(32, 0, frames[frame], FRAME_WIDTH, FRAME_HEIGHT, 1);
        display.display();
        delay(FRAME_DELAY);
    }
    display.clearDisplay(); // Limpa o display após a animação
}

const unsigned char circle_bitmap [] PROGMEM = {
    // Bitmap do círculo
    0b00111000,
    0b01111100,
    0b11111110,
    0b11111110,
    0b11111110,
    0b01111100,
    0b00111000,
    0b00010000
};

void printCharByChar(String text, unsigned int delayTime, int y) {
    int x = 0;
    display.clearDisplay(); // Limpa o display antes de começar a exibir o texto
    display.setTextSize(1); // Define o tamanho do texto
    display.setTextColor(WHITE); // Define a cor do texto
    for (int i = 0; i < text.length(); i++) {
        display.fillRect(x, y, SCREEN_WIDTH - x, 8, BLACK);
        display.setCursor(x, y);
        display.print(text[i]);
        if (i < text.length() - 1) {
            display.drawBitmap(x + 6, y, circle_bitmap, 8, 8, WHITE); // Desenha o círculo ao lado do último caractere
        }
        display.display();
        delay(delayTime);
        x += 6; // Ajuste a largura do caractere, se necessário
    }
    display.fillRect(x, y, SCREEN_WIDTH - x, 8, BLACK); // Limpa a área após o último caractere
    display.display(); // Atualiza o display após terminar de desenhar o texto
}


// Definições para a câmera ESP32-CAM
#define CAMERA_MODEL_AI_THINKER
#include "camera_pins.h"

void startCameraServer();

void setup() {
    Serial.begin(115200);
    Wire.begin(14, 15, 100000);

    if (!display.begin(SSD1306_SWITCHCAPVCC, SCREEN_I2C_ADDR)) {
        Serial.println("SSD1306 OLED display failed to initialize.");
        return;
    }

    runAnimation();

    WiFiManager wm;
    if (!wm.autoConnect("AuRA AI-MED", "auraneural")) {
        printCharByChar("Failed to connect", 100, 0);
        delay(3000);
        ESP.restart();
        return;
    }

    printCharByChar("WiFi Connected", 100, 0);
    printCharByChar(WiFi.localIP().toString(), 100, 10);

    // Configuração da câmera ESP32-CAM
    camera_config_t config;
    // ... (configuração da câmera)
    config.ledc_channel = LEDC_CHANNEL_0;
    config.ledc_timer = LEDC_TIMER_0;
    config.ledc_channel = LEDC_CHANNEL_0;
  config.ledc_timer = LEDC_TIMER_0;
  config.pin_d0 = Y2_GPIO_NUM;
  config.pin_d1 = Y3_GPIO_NUM;
  config.pin_d2 = Y4_GPIO_NUM;
  config.pin_d3 = Y5_GPIO_NUM;
  config.pin_d4 = Y6_GPIO_NUM;
  config.pin_d5 = Y7_GPIO_NUM;
  config.pin_d6 = Y8_GPIO_NUM;
  config.pin_d7 = Y9_GPIO_NUM;
  config.pin_xclk = XCLK_GPIO_NUM;
  config.pin_pclk = PCLK_GPIO_NUM;
  config.pin_vsync = VSYNC_GPIO_NUM;
  config.pin_href = HREF_GPIO_NUM;
  config.pin_sccb_sda = SIOD_GPIO_NUM;
  config.pin_sccb_scl = SIOC_GPIO_NUM;
  config.pin_pwdn = PWDN_GPIO_NUM;
  config.pin_reset = RESET_GPIO_NUM;
  config.xclk_freq_hz = 20000000;
  config.frame_size = FRAMESIZE_UXGA;
  config.pixel_format = PIXFORMAT_JPEG; // for streaming
  //config.pixel_format = PIXFORMAT_RGB565; // for face detection/recognition
  config.grab_mode = CAMERA_GRAB_WHEN_EMPTY;
  config.fb_location = CAMERA_FB_IN_PSRAM;
  config.jpeg_quality = 12;
  config.fb_count = 1;

    esp_err_t err = esp_camera_init(&config);
    if (err != ESP_OK) {
        printCharByChar("Camera init failed", 100, 20);
        return;
    }

    startCameraServer();

    printCharByChar("Camera Ready", 100, 30);
    printCharByChar("http://" + WiFi.localIP().toString(), 100, 40);
}

void loop() {
    delay(10000);
}

// Implementação da função startCameraServer e quaisquer outras funções auxiliares
// ...
